## firmware/components/api-server/Kconfig
```kconfig
menu "API Server Configuration"

    config API_SERVER_HOSTNAME
        string "mDNS Hostname"
        default "system-control"
        help
            The mDNS hostname for the API server.
            The device will be accessible at <hostname>.local

    config API_SERVER_PORT
        int "HTTP Server Port"
        default 80
        range 1 65535
        help
            The port number for the HTTP server.

    config API_SERVER_MAX_WS_CLIENTS
        int "Maximum WebSocket Clients"
        default 4
        range 1 8
        help
            Maximum number of concurrent WebSocket connections.

    config API_SERVER_ENABLE_CORS
        bool "Enable CORS"
        default y
        help
            Enable Cross-Origin Resource Sharing (CORS) headers.
            This is required for web interfaces served from different origins.

    config API_SERVER_STATIC_FILES_PATH
        string "Static Files Path"
        default "/spiffs/www"
        help
            Base path for serving static web files.

endmenu
```

## firmware/components/connectivity-manager/Kconfig
```kconfig
menu "Thread Configuration"

    config THREAD_JOINER_PSK
        string "Thread Joiner Pre-Shared Key (PSKd)"
        default "MAERKLN"
        help
            Password used during Thread commissioning (6-32 uppercase alphanumeric chars,
            no 0/O/I/Q). Must match the PSKd configured on the Commissioner (C6).

endmenu
```

## firmware/components/iris/Kconfig
```kconfig
menu "Iris Thread Manager"
    depends on IDF_TARGET_ESP32C6 || IDF_TARGET_ESP32H2

    config IRIS_ENABLED
        bool "Enable Iris Thread device management"
        default y
        depends on OPENTHREAD_ENABLED
        help
            Enables the Thread Border Router, Commissioner, and device management.
            Requires ESP32-C6 or ESP32-H2 target with OpenThread support.

    config IRIS_MAX_DEVICES
        int "Maximum number of paired Thread devices"
        default 32
        range 1 64
        depends on IRIS_ENABLED
        help
            Maximum number of paired H2 devices stored in SPIFFS and kept in memory.

    config IRIS_INVENTORY_INTERVAL_MS
        int "Inventory poll interval (ms)"
        default 30000
        range 5000 300000
        depends on IRIS_ENABLED
        help
            How often the inventory task polls all paired devices for their current state.

    config IRIS_OFFLINE_THRESHOLD
        int "Failed polls before marking device offline"
        default 3
        range 1 10
        depends on IRIS_ENABLED
        help
            Number of consecutive CoAP timeout/errors before a device is marked offline.

    config IRIS_DISCOVERY_WINDOW_MS
        int "Discovery response collection window (ms)"
        default 3000
        range 500 10000
        depends on IRIS_ENABLED
        help
            How long the C6 waits for responses after sending a multicast GET /discover.
            Longer values catch slow or distant devices; shorter values speed up boot.

    config IRIS_DISCOVERY_INTERVAL_CYCLES
        int "Re-discovery every N inventory cycles"
        default 10
        range 1 100
        depends on IRIS_ENABLED
        help
            A full discovery sweep (multicast GET /discover) is run automatically
            every N inventory poll cycles. At the default of 10 cycles × 30 s = 5 min.
            Set to 1 to rediscover every cycle (more network traffic).

    config IRIS_JOINER_PSKD
        string "Thread Joiner PSKd (Pre-Shared Key)"
        default "JOINPW01"
        depends on IRIS_ENABLED
        help
            The Pre-Shared Key for Device used during Thread commissioning.
            Must match the PSKd compiled into the H2 firmware.
            Minimum 6 characters, maximum 32 characters.

    config IRIS_MASTER_PRIORITY
        int "Master election priority (higher = preferred Master)"
        default 1
        range 1 255
        depends on IRIS_ENABLED
        help
            Priority used in Master/Backup election. The device with the highest
            priority becomes Master. Configure the primary C6 with a higher value
            (e.g., 2) than the backup (e.g., 1).

    config IRIS_MASTER_HEARTBEAT_INTERVAL_MS
        int "Master heartbeat broadcast interval (ms)"
        default 5000
        range 1000 30000
        depends on IRIS_ENABLED
        help
            How often the active Master broadcasts a heartbeat to the Thread multicast
            group ff03::1 so the Backup knows the Master is alive.

    config IRIS_MASTER_FAILOVER_TIMEOUT_MS
        int "Failover timeout — max time without a heartbeat (ms)"
        default 15000
        range 3000 60000
        depends on IRIS_ENABLED
        help
            If the Backup receives no heartbeat from the Master within this timeout,
            it starts a new Master election. Should be > 3 × HEARTBEAT_INTERVAL.

endmenu
```

## firmware/components/led-manager/Kconfig
```kconfig
menu "Led Manager Configuration"
    config WLED_DIN_PIN
        int "WLED Data In Pin"
        default 14
        help
            The number of the WLED data in pin.

    config STATUS_WLED_PIN
        int "Status WLED Pin"
        default 2
        help
            The number of the status WLED pin.

    config LED_STRIP_MAX_LEDS
        int "Maximum number of LEDs"
        default 800
        help
            The maximum number of LEDs that can be controlled.
endmenu
```

## firmware/components/my_mqtt_client/Kconfig
```kconfig
menu "MQTT Client Settings"

config MQTT_CLIENT_BROKER_URL
    string "MQTT Broker URL (TLS)"
    default "mqtts://example.com:8883"
    help
        Die Adresse des MQTT-Brokers (z.B. mqtts://broker.example.com:8883)

config MQTT_CLIENT_USERNAME
    string "MQTT Username"
    default "user"
    help
        Benutzername für die Authentifizierung (optional)

config MQTT_CLIENT_PASSWORD
    string "MQTT Password"
    default "password"
    help
        Passwort für die Authentifizierung (optional)

endmenu
```

## firmware/main/Kconfig.projbuild
```kconfig
menu "System Control"
    menu "WiFi Configuration"
        config WIFI_ENABLED
            bool    "Enable WiFi"
            default y
            help
                Enable or disable WiFi connectivity.

        config WIFI_CONNECT_RETRIES
            depends on WIFI_ENABLED
            int     "WiFi Connection Retry Attempts per Network"
            default 3
            help
                Number of times to retry connecting to each WiFi network before trying the next one.
    endmenu

    menu "Display Settings"
        config DISPLAY_SDA_PIN
            int     "I2C SDA Pin"
            default 35
            help
                GPIO pin number for the SDA line of the display.

        config DISPLAY_SCL_PIN
            int     "I2C SCL Pin"
            default 36
            help
                GPIO pin number for the SCL line of the display.
    endmenu

    menu "Button Configuration"
        config BUTTON_UP
            int     "Button UP GPIO Pin"
            default 1
            help
                GPIO pin number for the up button.

        config BUTTON_DOWN
            int     "Button DOWN GPIO Pin"
            default 6
            help
                GPIO pin number for the down button.

        config BUTTON_LEFT
            int     "Button LEFT GPIO Pin"
            default 3
            help
                GPIO pin number for the left button.
        
        config BUTTON_RIGHT
            int     "Button RIGHT GPIO Pin"
            default 5
            help
                GPIO pin number for the right button.
        
        config BUTTON_SELECT
            int     "Button SELECT GPIO Pin"
            default 18
            help
                GPIO pin number for the select button.

        config BUTTON_BACK
            int     "Button BACK GPIO Pin"
            default 16
            help
                GPIO pin number for the back button.
    endmenu
endmenu
```

## firmware/sdkconfig.defaults
```kconfig
# Logging
CONFIG_LOG_DEFAULT_LEVEL_INFO=y
CONFIG_LOG_DEFAULT_LEVEL=3
CONFIG_LOG_MAXIMUM_LEVEL=3

# Flash Size
CONFIG_ESPTOOLPY_FLASHSIZE_4MB=y

# Partitions
CONFIG_PARTITION_TABLE_CUSTOM=y
CONFIG_PARTITION_TABLE_CUSTOM_FILENAME="partitions.csv"
CONFIG_PARTITION_TABLE_FILENAME="partitions.csv"
CONFIG_PARTITION_TABLE_OFFSET=0x8000
CONFIG_PARTITION_TABLE_MD5=y

# LWIP / SNTP
CONFIG_LWIP_LOCAL_HOSTNAME="system-control"
CONFIG_LWIP_SNTP_MAX_SERVERS=1
CONFIG_LWIP_SNTP_UPDATE_DELAY=14400000
CONFIG_LWIP_SNTP_STARTUP_DELAY=y
CONFIG_LWIP_SNTP_MAXIMUM_STARTUP_DELAY=5000

# HTTP Server WebSocket Support
CONFIG_HTTPD_WS_SUPPORT=y

# System Event Task
CONFIG_ESP_SYSTEM_EVENT_TASK_STACK_SIZE=4096

# FreeRTOS timer service task — needs enough stack for ESP_LOG (printf → newlib lock chain)
CONFIG_FREERTOS_TIMER_TASK_STACK_DEPTH=4096

# Compiler Options
CONFIG_COMPILER_DISABLE_DEFAULT_ERRORS=y
CONFIG_ESP_SYSTEM_USE_FRAME_POINTER=y

# Certificate Bundle
CONFIG_MBEDTLS_CERTIFICATE_BUNDLE=y
CONFIG_MBEDTLS_CERTIFICATE_BUNDLE_DEFAULT_CMN=y
CONFIG_ESP_RMAKER_MQTT_USE_CERT_BUNDLE=n

# OpenThread
CONFIG_OPENTHREAD_ENABLED=y
CONFIG_OPENTHREAD_BORDER_ROUTER=n
CONFIG_OPENTHREAD_COMMISSIONER=y
CONFIG_OPENTHREAD_NETWORK_CHANNEL=18
CONFIG_OPENTHREAD_NUM_MESSAGE_BUFFERS=128
CONFIG_LWIP_IPV6_NUM_ADDRESSES=12

# mbedTLS: required for Thread commissioning (DTLS + J-PAKE + HKDF)
CONFIG_MBEDTLS_SSL_PROTO_DTLS=y
CONFIG_MBEDTLS_SSL_RENEGOTIATION=y
CONFIG_MBEDTLS_KEY_EXCHANGE_ECJPAKE=y
CONFIG_MBEDTLS_ECJPAKE_C=y
CONFIG_MBEDTLS_PSK_MODES=y
CONFIG_MBEDTLS_KEY_EXCHANGE_PSK=y
CONFIG_MBEDTLS_HKDF_C=y

# WiFi: reduce DMA buffers to free heap for Thread coexistence
CONFIG_ESP_WIFI_STATIC_RX_BUFFER_NUM=4
CONFIG_ESP_WIFI_DYNAMIC_RX_BUFFER_NUM=8
CONFIG_ESP_WIFI_DYNAMIC_TX_BUFFER_NUM=8

# mbedTLS: dynamic buffers (only allocated while connection is active)
CONFIG_MBEDTLS_DYNAMIC_BUFFER=y
CONFIG_MBEDTLS_ASYMMETRIC_CONTENT_LEN=y
CONFIG_MBEDTLS_SSL_OUT_CONTENT_LEN=4096

# WiFi/Thread Coexistence
CONFIG_ESP_COEX_SW_COEXIST_ENABLE=y
CONFIG_IEEE802154_COEXIST_ENABLE=y
```

## firmware/sdkconfig.defaults.esp32c6
```kconfig
# default ESP target
CONFIG_IDF_TARGET="esp32c6"

#
# Display Settings
#
CONFIG_DISPLAY_SDA_PIN=22
CONFIG_DISPLAY_SCL_PIN=23
# end of Display Settings

#
# Button Configuration
#
CONFIG_BUTTON_UP=18
CONFIG_BUTTON_DOWN=17
CONFIG_BUTTON_LEFT=20
CONFIG_BUTTON_RIGHT=19
CONFIG_BUTTON_SELECT=1
CONFIG_BUTTON_BACK=2
# end of Button Configuration

CONFIG_WLED_DIN_PIN=21
CONFIG_STATUS_WLED_PIN=16

CONFIG_API_SERVER_HOSTNAME="system-control"

CONFIG_LWIP_MAX_SOCKETS=20

#
# System event task stack size
#
CONFIG_ESP_SYSTEM_EVENT_TASK_STACK_SIZE=4096

#
# OpenThread (Thread Border Router + Commissioner)
# Required for Iris Thread device management on ESP32-C6
#
CONFIG_OPENTHREAD_ENABLED=y
CONFIG_OPENTHREAD_BORDER_ROUTER=y
CONFIG_OPENTHREAD_COMMISSIONER=y
CONFIG_OPENTHREAD_JOINER=n
CONFIG_OPENTHREAD_RADIO_NATIVE=y

#
# IPv6 — required for Thread
#
CONFIG_LWIP_IPV6=y
CONFIG_LWIP_IPV6_NUM_ADDRESSES=12

#
# mbedTLS — DTLS + ECJPAKE required by OpenThread Commissioner/Joiner
#
CONFIG_MBEDTLS_SSL_PROTO_DTLS=y
CONFIG_MBEDTLS_KEY_EXCHANGE_ECJPAKE=y
CONFIG_MBEDTLS_ECJPAKE_C=y

#
# Iris — Thread device manager
#
CONFIG_IRIS_ENABLED=y
CONFIG_IRIS_MASTER_PRIORITY=1
```

## firmware/sdkconfig.defaults.esp32s3
```kconfig
# default ESP target
CONFIG_IDF_TARGET="esp32s3"

CONFIG_API_SERVER_HOSTNAME="system-client"

# ESP PSRAM
CONFIG_SPIRAM=y

# SPI RAM config
CONFIG_SPIRAM_SPEED=80
CONFIG_SPIRAM_USE_CAPS_ALLOC=y
```
